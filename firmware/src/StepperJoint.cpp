#include "Joint.h"
#include "TmcBus.h"
#include <math.h>

const char* errName(ErrCode e) {
  switch (e) {
    case E_OK:             return "ok";
    case E_SYNTAX:         return "syntax";
    case E_UNKNOWN_CMD:    return "unknown-command";
    case E_BAD_JOINT:      return "bad-joint";
    case E_OUT_OF_RANGE:   return "out-of-range";
    case E_NOT_ATTACHED:   return "not-attached";
    case E_DISABLED:       return "disabled";
    case E_DRIVER_OFFLINE: return "driver-offline";
    case E_BAD_PIN:        return "bad-pin";
    case E_BAD_VALUE:      return "bad-value";
    case E_ESTOP:          return "estop";
    case E_TIMEOUT:        return "timeout";
    case E_UNSUPPORTED:    return "unsupported";
  }
  return "unknown";
}

// ===========================================================================
//  Direction over UART, through FastAccelStepper's external-pin hook.
//
//  Why not simply leave the direction pin undefined: FastAccelStepper then
//  silently refuses to emit down-counting steps. moveTo() still returns
//  MOVE_OK, the ramp runs, the position counter does not move, and the joint
//  just sits there. That is exactly the failure this firmware shipped with:
//      move+5 shaft=0 steps=+42
//      move-5 shaft=1 steps=+0     <- correct shaft bit, zero steps
//
//  The library has a proper mechanism for drivers whose direction line is not
//  a GPIO. Set the direction pin to (PIN_EXTERNAL_FLAG | joint) and register
//  a callback on the engine; FastAccelStepper then drains the step queue,
//  calls the callback, and only emits steps in the new direction once the
//  callback confirms. If the callback reports the change has not landed yet,
//  it inserts a 2 ms pause and asks again - which is what makes a ~0.7 ms
//  UART datagram safe to do here.
//
//  The callback runs on FastAccelStepper's StepperTask, not in an ISR.
// ===========================================================================
static volatile uint16_t s_dirFaults[STEPPER_COUNT] = {0};

static bool tmcExternalDirPin(uint8_t pin, uint8_t value) {
  const uint8_t joint = (uint8_t)(pin & 0x7F);
  if (joint >= STEPPER_COUNT) return value == HIGH;

  // setDirectionPin() was called with dirHighCountsUp = true, so HIGH means
  // count up, which is the positive joint direction.
  const bool wantPositive = (value == HIGH);

  if (tmcBus.directionKnown(joint) &&
      tmcBus.directionPositive(joint) == wantPositive) {
    s_dirFaults[joint] = 0;
    return wantPositive;                  // already there, no bus traffic
  }
  if (tmcBus.setDirection(joint, wantPositive)) {
    s_dirFaults[joint] = 0;
    return wantPositive;
  }
  // Report the pin as unchanged: FastAccelStepper pauses and retries rather
  // than stepping in a direction the driver was never told about.
  s_dirFaults[joint]++;
  return !wantPositive;
}

uint16_t StepperJoint::dirFaults(uint8_t i) {
  return (i < STEPPER_COUNT) ? s_dirFaults[i] : 0;
}
void StepperJoint::clearDirFaults() {
  for (uint8_t i = 0; i < STEPPER_COUNT; i++) s_dirFaults[i] = 0;
}

// Map FastAccelStepper refusals onto our own error codes. Discarding these
// is what let a dead axis look like a working one.
static ErrCode fromMoveResult(MoveResultCode r) {
  if (r == MOVE_OK) return E_OK;
  if (r == MOVE_ERR_NO_DIRECTION_PIN) return E_BAD_PIN;
  return E_BAD_VALUE;      // speed or acceleration not configured yet
}

// One engine for the whole firmware. On the classic ESP32 it can hand out 14
// hardware step queues (6 MCPWM+PCNT, 8 RMT), so three joints - or six - are
// nowhere near the limit, and the pulses are generated by peripherals rather
// than by the CPU.
FastAccelStepperEngine& StepperJoint::engine() {
  static FastAccelStepperEngine e = FastAccelStepperEngine();
  static bool started = false;
  if (!started) {
    e.init();
    // Must be registered before any setDirectionPin() call - that call
    // invokes the callback immediately to establish the initial state.
    e.setExternalCallForPin(tmcExternalDirPin);
    started = true;
  }
  return e;
}

bool StepperJoint::begin(uint8_t index, Print& log) {
  idx = index;
  const JointPins& p = JPIN[idx];

  const char* why = pinUnusableReason(p.step);
  if (why) {
    log.printf("# !! %s STEP GPIO%u unusable: %s\n", cfg().name, p.step, why);
    return false;
  }
  if (pinOwner(idx, p.step) >= 0) {
    log.printf("# !! %s STEP GPIO%u is claimed twice - not attaching\n",
               cfg().name, p.step);
    return false;
  }

  st = engine().stepperConnectToPin(p.step);
  if (!st) {
    log.printf("# !! %s could not get a step generator for GPIO%u\n",
               cfg().name, p.step);
    return false;
  }

  // A VIRTUAL direction pin. Nothing is wired to it; the number just tells
  // FastAccelStepper to route direction changes through the callback above,
  // which writes the TMC2209 shaft bit over UART.
  st->setDirectionPin((uint8_t)(PIN_EXTERNAL_FLAG | idx), true, 0);
  st->setAutoEnable(false);          // the enable line is ours to drive
  st->setSpeedInHz((uint32_t)maxStepRate());
  st->setAcceleration((int32_t)fmaxf(1.0f, cfg().maxAccDeg * stepsPerDegree()));
  st->setCurrentPosition(0);

  pinMode(p.enable, OUTPUT);
  digitalWrite(p.enable, HIGH);      // active low: HIGH = de-energised
  return true;
}

// steps/deg = motor steps * microsteps * gear / 360.
float StepperJoint::stepsPerDegree() const {
  const JointConfig& c = cfg();
  return (c.motorStepsPerRev * (float)c.microsteps * c.gearRatio) / 360.0f;
}

float StepperJoint::maxStepRate() const {
  return fmaxf(1.0f, cfg().maxVelDeg * stepsPerDegree());
}

long StepperJoint::degreesToSteps(float deg) const {
  return lroundf(deg * stepsPerDegree());
}

void StepperJoint::setEnabled(bool on) {
  digitalWrite(JPIN[idx].enable, on ? LOW : HIGH);
}

float StepperJoint::position() const {
  if (!st) return 0.0f;
  return (float)st->getCurrentPosition() / stepsPerDegree();
}

void StepperJoint::redefinePosition(float deg) {
  if (st) st->setCurrentPosition(degreesToSteps(deg));
}

bool StepperJoint::isMoving() const {
  return st && st->isRunning();
}

// Pre-set the direction for an upcoming move.
//
// Not strictly required any more - the external-pin callback handles direction
// on its own, including reversals in the middle of a move, because
// FastAccelStepper drains the step queue before asking for the change. This
// exists for one reason: when the joint is idle we can do the UART write HERE,
// in the caller's context, verify it, and still refuse the move if the bus is
// dead. From inside the callback the only way to signal a problem is to stall
// the axis, which is a much worse way to find out.
ErrCode StepperJoint::prepareDirection(float deg) {
  if (!st) return E_NOT_ATTACHED;
  const long target = degreesToSteps(deg);
  const long now    = st->getCurrentPosition();
  if (target == now) return E_OK;              // no motion, no direction

  // Already moving: FastAccelStepper owns the changeover. Do not fight it.
  if (st->isRunning()) return E_OK;

  if (!tmcBus.setDirection(idx, target > now)) return E_DRIVER_OFFLINE;
  return E_OK;
}

ErrCode StepperJoint::moveTo(float deg, float feed) {
  if (!st) return E_NOT_ATTACHED;
  const ErrCode e = checkTravel(deg);
  if (e != E_OK) return e;
  const ErrCode d = prepareDirection(deg);
  if (d != E_OK) return d;

  feed = constrain(feed, 0.001f, 1.0f);
  st->setSpeedInHz((uint32_t)fmaxf(1.0f, maxStepRate() * feed));
  st->setAcceleration((int32_t)fmaxf(1.0f, cfg().maxAccDeg * stepsPerDegree() * feed));
  st->applySpeedAcceleration();
  return fromMoveResult(st->moveTo(degreesToSteps(deg)));
}

// Trapezoid time, honestly computed: if the move is too short to reach full
// speed it is triangular and the cruise term drops out. Getting this wrong
// makes coordinated moves drift apart on short segments.
float StepperJoint::estimateSeconds(float deg, float feed) const {
  if (!st) return 0.0f;
  feed = constrain(feed, 0.001f, 1.0f);
  const float dist = fabsf(deg - position());
  if (dist <= 0.0f) return 0.0f;

  const float v = fmaxf(0.001f, cfg().maxVelDeg * feed);
  const float a = fmaxf(0.001f, cfg().maxAccDeg * feed);
  const float distToReachV = (v * v) / a;          // accelerate then decelerate

  if (dist < distToReachV) return 2.0f * sqrtf(dist / a);
  return (v / a) + (dist / v);
}

ErrCode StepperJoint::moveToTimed(float deg, float seconds) {
  if (!st) return E_NOT_ATTACHED;
  const ErrCode e = checkTravel(deg);
  if (e != E_OK) return e;
  if (seconds <= 0.0f) return moveTo(deg, 1.0f);
  const ErrCode d = prepareDirection(deg);
  if (d != E_OK) return d;

  const float dist = fabsf(deg - position());
  if (dist <= 0.0f) return fromMoveResult(st->moveTo(degreesToSteps(deg)));

  // Solve the trapezoid backwards for the velocity that lands on `seconds`,
  // keeping the acceleration proportional so the profile shape is preserved.
  float v = dist / seconds;
  if (v > cfg().maxVelDeg) v = cfg().maxVelDeg;        // cannot go faster
  const float scale = v / fmaxf(0.001f, cfg().maxVelDeg);
  const float a = fmaxf(0.001f, cfg().maxAccDeg * scale);

  st->setSpeedInHz((uint32_t)fmaxf(1.0f, v * stepsPerDegree()));
  st->setAcceleration((int32_t)fmaxf(1.0f, a * stepsPerDegree()));
  st->applySpeedAcceleration();
  return fromMoveResult(st->moveTo(degreesToSteps(deg)));
}

void StepperJoint::stop(bool immediate) {
  if (!st) return;
  if (immediate) st->forceStop();
  else           st->stopMove();
}
